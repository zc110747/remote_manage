// SPDX-License-Identifier: (GPL-2.0 OR MIT)
//
// Copyright (C) 2016 Freescale Semiconductor, Inc.

/dts-v1/;

#include "imx6ull.dtsi"
#include "imx6ul-14x14-hello.dtsi"
#include "imx6ul-14x14-hello-u-boot.dtsi"

/ {
	model = "i.MX6 ULL 14x14 HELLO Board";
	compatible = "fsl,imx6ull-14x14-hello", "fsl,imx6ull";
};

&clks {
	assigned-clocks = <&clks IMX6UL_CLK_PLL3_PFD2>;
	assigned-clock-rates = <320000000>;
};
